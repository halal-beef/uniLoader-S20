## configs/pacman_defconfig
```kconfig
CONFIG_POSITION_INDEPENDENT=y
# CONFIG_COMPRESS_GZIP is not set
CONFIG_COMPRESS_LZ4=y
CONFIG_MT6886=y
CONFIG_NOTHING_PACMAN=y
CONFIG_TEXT_BASE=0x40000000
CONFIG_PAYLOAD_ENTRY=0x60000000
CONFIG_RAMDISK_ENTRY=0x51100000
```

## configs/wasp_defconfig
```kconfig
CONFIG_CROSS_COMPILE="aarch64-linux-gnu-"
CONFIG_MEDIATEK_MT6761=y
CONFIG_NOKIA_WASP=y
```
