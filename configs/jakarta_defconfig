## configs/jakarta_defconfig
```kconfig
CONFIG_CROSS_COMPILE="aarch64-linux-gnu-"
CONFIG_MEDIATEK_MT6765=y
CONFIG_HUAWEI_JAKARTA=y
```

## configs/vayu_defconfig
```kconfig
CONFIG_CROSS_COMPILE="aarch64-linux-gnu-"
CONFIG_QC64_SM8150=y
CONFIG_XIAOMI_VAYU=y
```
